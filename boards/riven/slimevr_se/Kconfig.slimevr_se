## boards/riven/slimevr_se/Kconfig.slimevr_se
```kconfig
# Copyright (c) 2024 Nordic Semiconductor ASA
# SPDX-License-Identifier: Apache-2.0

config BOARD_SLIMEVR_SE
	select SOC_NRF52840_QIAA
# config BOARD_SLIMEVR_SE_NRF52840_SPI
# 	select SOC_NRF52840_QIAA
```

## boards/riven/slimevr_se/board.yml
```yaml
# Copyright (c) 2024 Nordic Semiconductor ASA
# SPDX-License-Identifier: Apache-2.0

board:
  name: slimevr_se
  vendor: riven
  socs:
    - name: nrf52840
```
